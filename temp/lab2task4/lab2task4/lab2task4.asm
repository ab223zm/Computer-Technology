/*
 * lab2task4.asm
 *
 *  Created: 9/16/2017 6:12:50 PM
 *   Author: Ruthi
 */ 

 .include "m2560def.inc"

; Initialize SP, Stack Pointer
ldi r20, HIGH(RAMEND) ; R20 = high part of RAMEND address
out SPH,r20 ; SPH = high part of RAMEND address
ldi R20, low(RAMEND) ; R20 = low part of RAMEND address
out SPL,R20 ; SPL = low part of RAMEND address

ldi r24, low(600)
ldi r25, HIGH(600)

ldi r20, 0xFF
out DDRB, r20				; All one's to DDRB, outputs

ldi r16, 0xFE				; starting with LED0

floop:
cpi r16, 0xFF				; checking if all LEDs are off
breq equal				
out PORTB, r16				; write in PORTB, turning on LEDs
com r16					; inverting the bits of r16				
lsl r16					; pushing a 0 to the left
com r16					; inverting the bits of r16 again
rjmp delay
rjmp floop

equal: 
ldi r16, 0xFE			

rjmp floop

; Generated by delay loop calculator
; at http://www.bretmulvey.com/avrdelay.html
;
; Delay 500 000 cycles
; 500ms at 1 MHz

delay:
	
    ldi  r18, 3
    ldi  r19, 138
    ldi  r21, 86
L1: dec  r21
    brne L1
    dec  r19
    brne L1
    dec  r18
    brne L1
    rjmp PC+1

rjmp floop

